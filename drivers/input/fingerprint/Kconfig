## drivers/input/fingerprint/Kconfig
```kconfig
menuconfig BBK_FINGERPRINT
	tristate "BBK FINGERPRINT support"
	help
	  Say Y here to enable fingerprint

if BBK_FINGERPRINT
config BBK_FP_MODULE
	bool "BBK fingerprint modules"
	help 
	  Say Y here to enable fingerprint modules
	
config BBK_FP_ID
	tristate "detect fingerprint id"
	help
	  there is nothing for help!

source "drivers/input/fingerprint/gf3208/Kconfig"

endif
```

## kernel/rsc/Kconfig
```kconfig
#
# VIVO	 Resource Control config, call RSC
#

config RSC_V2
	bool "VIVO Resource Control"
	default y
	help
	  This will enable VIVO Resource Control.

config RSC_V2_CPU_CAP_NOTIFY
        boolean "RSC CPU capability notify Config"
        depends on RSC_V2
        default y
        help
          If you say Y here, support will be enable cpu capability notify.

config RSC_TASK_CPU_USAGE
        boolean "RSC task cpu usage Config"
        depends on RSC_V2
        default y
        help
          If you say Y here, support will be enable task cpu usage.

config RSC_UID_IO
        boolean "RSC uid io Config"
        depends on RSC_V2
        default y
        help
          If you say Y here, support will be enable stat io by uid.

config RSC_CHECK_LMK
        boolean "RSC check task killed by lmk"
        depends on RSC_V2
        default y
        help
          If you say Y here, support will be enable check task killed by lmk.

config RSC_CPU_TOP
        boolean "RSC feed back process cpu usage"
        depends on RSC_V2
        default y
        help
          If you say Y here, support will feed back cpu usage, replay top command.

config RSC_IOLIMIT
        boolean "RSC limit io by cgroup"
        depends on RSC_V2 && BLK_CGROUP
        default y
        help
          If you say Y here, support will limit io.
```

## sound/soc/vivo/Kconfig
```kconfig
#
# ViVo SoC codec configuration
#

# menu "vivo HiFi Soc Audio Support"

config VIVO_SOC_CODEC
	bool "vivo soc codec"
	help
		this is for vivo soc codec, including dac hifi, speaker smart pa, ktv and so on.
		
config VIVO_CODEC_PD1611F
	bool "vivo codec for pd1611f"
	help
		this is for vivo codec of pd1611f,including dac hifi, speaker smart pa,ktv ans so on

config VIVO_CODEC_PD1612
	bool "vivo codec for pd1612"
	help
		this is for vivo codec of pd1612,including dac hifi, speaker smart pa,ktv ans so on
		
config VIVO_CODEC_PD1612F
	bool "vivo codec for pd1612f"
	help
		this is for vivo codec of pd1612f,including dac hifi, speaker smart pa,ktv ans so on

config VIVO_CODEC_PD1524BA_6_0
	bool "vivo codec for pd1524ba 6.0"
	help
		this is for vivo codec of pd1524ba 6.0,including dac hifi, speaker smart pa,ktv ans so on
		
config AK4375
	bool "DAC AK4375"
	help
		This is for AK4375 DAC, for audio hifi performance
		
config AK4376
	bool "DAC AK4376"
	help
		This is for AK4376 DAC, for audio hifi performance
		
config SPK_TFA98XX
	bool "Smart pa for loundspeaker"
	help 
		This is for loundspeaker smart pa supported
		
config NXP_TFA98XX
	tristate "NXP Smart PA TFA98xx"
	help
		This is for nxp smart pa for speaker performance
		
config HIFI_CS4398
	bool "CS4398 DAC Enable"
	help
		This item configs external dac cs4398 supported.

config HIFI_ES9028
	bool "ES9028 DAC Enable"
	help
		This item configs external dac es9028 supported.
		
		
config KTV_YAMAHA
	bool "Yamaha ymu831 Enable"
	help
		This item configs external dac by ktv supported.
		
config VIVO_REGDUMP
	bool "vivo Audio IC Register dump Enable"
	
config VIVO_CODEC_FOR_MTK
	bool "vivo codec driver for mtk platform"
	help
		enable it if it's mtk platform, disable it if it is not

config SND_TFA9891
	bool "Enable TFA9891"
	help
		To add support for SoC audio on TFA9891.
# endmenu
```
